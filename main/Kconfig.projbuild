## main/Kconfig.projbuild
```kconfig
menu "ESP32 MCP Node"

choice APP_BOARD
    prompt "Board profile"
    default APP_BOARD_YD_S3
    config APP_BOARD_YD_S3
        bool "YD-ESP32-S3 N16R8 (no LCD)"
    config APP_BOARD_WAVESHARE_43B
        bool "Waveshare ESP32-S3-Touch-LCD-4.3B"
endchoice

config APP_ENABLE_DISPLAY
    bool "Enable LCD display and UI"
    default n

choice APP_DISPLAY_BACKEND
    depends on APP_ENABLE_DISPLAY
    prompt "Display backend"
    default APP_DISPLAY_BACKEND_MOCK
    config APP_DISPLAY_BACKEND_MOCK
        bool "Mock backend (logs only, no LCD)"
    config APP_DISPLAY_BACKEND_LVGL
        bool "LVGL RGB backend"
endchoice

config APP_DISPLAY_MAX_PAGES
    depends on APP_ENABLE_DISPLAY
    int "Maximum UI pages"
    range 1 8
    default 4

config APP_DISPLAY_MAX_SCENE_BYTES
    depends on APP_ENABLE_DISPLAY
    int "Maximum scene JSON size"
    range 2048 32768
    default 16384

config APP_DISPLAY_DEFAULT_BRIGHTNESS
    depends on APP_ENABLE_DISPLAY
    int "Default brightness (0-100)"
    range 0 100
    default 70

config APP_DISPLAY_TIMEZONE
    depends on APP_ENABLE_DISPLAY
    string "Timezone (POSIX TZ)"
    default "CST-8"

config APP_DISPLAY_NTP_SERVER
    depends on APP_ENABLE_DISPLAY
    string "NTP server"
    default "pool.ntp.org"

config APP_DISPLAY_ALLOW_DO_WRITE
    depends on APP_ENABLE_DISPLAY
    bool "Allow MCP clients to write isolated DO outputs"
    default n

config APP_DISPLAY_IMAGE_URL_PREFIX
    depends on APP_ENABLE_DISPLAY
    string "Allowed image URL prefix (empty = disabled)"
    default ""

config APP_FW_VERSION
    string "Firmware version"
    default "0.1.0"

config APP_MCP_PORT
    int "MCP HTTP port"
    default 8080

config APP_WEB_PORT
    int "Provisioning/status HTTP port"
    default 80

config APP_AP_PREFIX
    string "SoftAP SSID prefix"
    default "ESP32-MCP"

config APP_AP_PASSWORD
    string "SoftAP password (min 8 chars)"
    default "esp32mcp"

config APP_HOSTNAME_PREFIX
    string "mDNS hostname prefix"
    default "esp32-mcp"

config APP_GPIO_ALLOWLIST
    string "Allowed GPIO list (comma separated)"
    default "4,5,6,7,8,15,16,17,18,21,38"

config APP_GPIO_ALLOW_WRITE
    bool "Allow MCP clients to write GPIO"
    default y

config APP_LED_GPIO
    int "WS2812 GPIO"
    default 48

config APP_MCP_RATE_LIMIT
    int "MCP calls per second"
    default 10

config APP_MCP_IN_AP_MODE
    bool "Expose MCP while in provisioning AP mode"
    default n

config APP_ENABLE_MDNS
    bool "Enable mDNS advertisement"
    default y

config APP_MCP_ALLOW_OTA
    bool "Allow MCP clients to trigger OTA"
    default y

config APP_OTA_ALLOWED_URL_PREFIX
    string "Allowed OTA URL prefix"
    default "http://192.168.3.110:8000/"

config APP_OTA_ALLOW_DOWNGRADE
    bool "Allow OTA downgrade"
    default n

config APP_OTA_HEALTH_TIMEOUT_MS
    int "OTA health check timeout (ms)"
    default 30000

endmenu
```

## sdkconfig.defaults
```kconfig
CONFIG_IDF_TARGET="esp32s3"

CONFIG_ESPTOOLPY_FLASHSIZE_16MB=y
CONFIG_ESPTOOLPY_FLASHSIZE="16MB"
CONFIG_SPIRAM=y
CONFIG_SPIRAM_MODE_OCT=y
CONFIG_SPIRAM_SPEED_80M=y

CONFIG_PARTITION_TABLE_CUSTOM=y
CONFIG_PARTITION_TABLE_CUSTOM_FILENAME="partitions.csv"
CONFIG_BOOTLOADER_APP_ROLLBACK_ENABLE=y

CONFIG_ESP_COREDUMP_ENABLE_TO_FLASH=y

CONFIG_ESP_MAIN_TASK_STACK_SIZE=8192
CONFIG_LWIP_MAX_SOCKETS=16
CONFIG_ESP_WIFI_STATIC_RX_BUFFER_NUM=8
CONFIG_ESP_WIFI_DYNAMIC_RX_BUFFER_NUM=16

CONFIG_MCP_TRANSPORT_HTTP_SERVER=y
CONFIG_MCP_HTTP_SSE_ENABLE=y
CONFIG_MCP_HTTP_SSE_MAX_CLIENTS=2
CONFIG_MCP_HTTP_SSE_QUEUE_LEN=16
CONFIG_MCP_HTTP_SESSION_TTL_MS=3600000
CONFIG_MCP_HTTP_CORS_ENABLE=n
CONFIG_MCP_HTTP_OAUTH_METADATA_ENABLE=n
CONFIG_MCP_HTTP_DEFAULT_PROTOCOL_VERSION="2025-11-25"
CONFIG_MCP_HTTP_AUTH_ENABLE=y
CONFIG_MCP_HTTP_AUTH_BEARER_TOKEN="dev-token-change-me"
CONFIG_MCP_TOOLCALL_STACK_SIZE=8192
CONFIG_MCP_TOOLLIST_MAX_SIZE=16384

CONFIG_MDNS_MAX_SERVICES=4

CONFIG_APP_MCP_ALLOW_OTA=y
CONFIG_APP_OTA_ALLOWED_URL_PREFIX="http://192.168.3.110:8000/"
```
